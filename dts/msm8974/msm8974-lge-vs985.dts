// SPDX-License-Identifier: GPL-2.0-only

/dts-v1/;

#include <skeleton.dtsi>
#include <lk2nd.h>

/ {
	// This is used by the bootloader to find the correct DTB
	qcom,msm-id = <194 118 0x10001>, // AA/AB variant
								<194 113 0x10001>; // AC variant

	model = "LG G3 (VS985)";
	compatible = "lge,vs985", "qcom,msm8974", "lk2nd,device";
	lk2nd,match-cmdline = "*androidboot.serialno=VS985*";

	lk2nd,keys =
		<KEY_VOLUMEUP   PM_GPIO(2) PM_GPIO_PULL_UP_1_5>,
		<KEY_VOLUMEDOWN PM_GPIO(3) PM_GPIO_PULL_UP_1_5>;
};
